## sdkconfig.defaults
```kconfig
CONFIG_ESPTOOLPY_FLASHSIZE_2MB=y
CONFIG_PARTITION_TABLE_CUSTOM=y
CONFIG_PARTITION_TABLE_CUSTOM_FILENAME="partitions.csv"

# Increase Timer Service task stack to prevent overflow
CONFIG_FREERTOS_TIMER_TASK_STACK_DEPTH=4096
```
